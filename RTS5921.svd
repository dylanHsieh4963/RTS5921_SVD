# RTS5921 register map
Vendor: Realtek Semiconductor Corp.; Series: RTS5921 Series; File version: 0.01
Realtek Real-M300 Arm v8-M Instruction Processor
CPU: ARMV8MBL r0p0, little endian, MPU, no FPU, VTOR, 3 interrupt priority bits
Registers are 32-bit, read-write, reset 0x0 unless marked. A register's access mark holds for its fields unless they carry their own. Offsets are from the block's base; lines under a group give offsets from that group; [hi:lo] are bit positions; {n}, {i} and the like mark numbered series; 'fields as' and 'values as' point back to an identical list; <NAME> marks a mode.

## Memory map
0x40000000 INTR_SPIC size 0x1000 — Realtek RXI-312 SPI Controller
0x40001000 EXTR_SPIC size 0x1000
0x40002000 DMA size 0x1000 — Realtek RXI-350 DMA Controller
0x40003000 I3C0 size 0x1000 — USB OTG Controller
0x40040000 USB_CORE size 0x200 — USB OTG Controller
0x40040400 USB_HOST size 0x200 — USB OTG Host Controller
0x40040800 USB_DEVICE size 0x100 — USB OTG Device Controller
0x40040900 USB_IN_EP size 0x200 — USB OTG IN-Endpoint Controller
0x40040B00 USB_OUT_EP size 0x400 — USB OTG Out-Endpoint Controller
0x40100000 SYSTEM size 0x100 — System Controller
0x40100100 RCCAL size 0x20 — RC Calibration Controller
0x40100300 SPIM size 0x100 — SPI Master Controller
0x40100400 SPIS size 0x100
0x40100700 UART size 0x100 — UART Controller
0x40100800 ADC size 0x100 — SAR ADC Controller
0x40100900 TACHO0 size 0x20 — Tachometer Controller
0x40100920 TACHO1 size 0x20
0x40100940 TACHO2 size 0x20
0x40100960 TACHO3 size 0x20
0x40100980 WDT size 0x20 — WDT Controller
0x40100A00 I2CDBG size 0x20 — I2C Debug Controller
0x40101000 I2C0 size 0x200 — DW I2C Controller
0x40101200 I2C1 size 0x200
0x40101400 I2C2 size 0x200
0x40101600 STRIP0 size 0x100 — ARGB LED STRIP Controller
0x40101700 STRIP1 size 0x100
0x40101800 STRIP2 size 0x100
0x40101900 STRIP3 size 0x100
0x40101A00 STRIP4 size 0x100
0x40101B00 STRIP5 size 0x100
0x40101C00 STRIP6 size 0x100
0x40101D00 STRIP7 size 0x100
0x40110000 GPIO size 0x1000 — GPIO Controller
0x40121000 LED0 size 0x20 — PWM LED Controller
0x40121020 LED1 size 0x20
0x40121040 PWM0 size 0xC — PWM Controller
{0x40121040+0x20*n} PWM{n} size 0xC (n=1..29)
0x40121400 TMR0 size 0x10 — Timer Controller
0x40121420 TMR1 size 0x10
0x40121440 TMR2 size 0x10
0x40121460 TMR3 size 0x10
0x40122000 CRC32 size 0x100 — CRC32 Engine
0x40122100 KBM size 0x100 — Keyboard Matrix Controller
0x40122600 THERMAL_CAL size 0x100 — Thermal Calibration Engine

## Interrupts
0 GPIOA (GPIO) — GPIO PORTA Interrupt
1 GPIOB (GPIO) — GPIO PORTB Interrupt
2 GPIOC (GPIO) — GPIO PORTC Interrupt
3 GPIOD (GPIO) — GPIO PORTD Interrupt
4 GPIOE (GPIO) — GPIO PORTE Interrupt
5 GPIOF (GPIO) — GPIO PORTF Interrupt
6 GPIOG (GPIO) — GPIO PORTG Interrupt
7 GPIOH (GPIO) — GPIO PORTH Interrupt
8 DMA — DMA Controller Interrupt
9 EXTR_SPIC — External SPIC Interrupt
10 INTR_SPIC — Internal SPIC Interrupt
11 I3C (I3C0) — I3C Interrupt
12 USB (USB_CORE) — USB OTG Interrupt
13 SPIM — SPI Master Interrupt
14 SPIS — SPI Slave Interrupt
15 UART — UART Interrupt
16 I2C0 — I2C0 Interrupt
17 I2C1 — I2C1 Interrupt
18 I2C2 — I2C2 Interrupt
24 WDT — WDT Interrupt
25 TMR0 — TMR0 Interrupt
26 TMR1 — TMR1 Interrupt
27 TMR2 — TMR2 Interrupt
28 TMR3 — TMR3 Interrupt
30 KBM — KBM Interrupt
{n+31} STRIP{n} (n=0..7) — STRIP{n} Interrupt
40 TACHO0 — TACHO0 Interrupt
41 TACHO1 — TACHO1 Interrupt
42 TACHO2 — TACHO2 Interrupt
43 TACHO3 — TACHO3 Interrupt
44 I2CDBG0 (I2CDBG) — I2CDBG0 Interrupt
45 I2CDBG1 (I2CDBG) — I2CDBG1 Interrupt
46 I2CDBG2 (I2CDBG) — I2CDBG2 Interrupt

## USB_HOST — USB OTG Host Controller
Base 0x40040400
0x00 HCFG — Host Configuration Register
0x04 HFIR — Host Frame Interval Register
0x08 HFNUM ro — Host Frame Number/Frame Time Remaining Register
0x10 HPTXSTS ro — Host Periodic Transmit FIFO/Queue Status Register
0x14 HAINT ro — Host All Channels Interrupt Register
0x18 HAINTMSK — Host All Channels Interrupt Mask Register
0x1C HFLBAddr — Host Frame List Base Address Register
0x40 HPRT — Host Port Control and Status Register
{0x100+0x20*i} HCCHAR{i} (i=0..3) — Host Channel {i} Characteristics Register
{0x104+0x20*i} HCSPLT{i} (i=0..3) — Host Channel {i} Split Control Register
{0x108+0x20*i} HCINT{i} (i=0..3) — Host Channel {i} Interrupt Register
{0x10C+0x20*i} HCINTMSK{i} (i=0..3) — Host Channel {i} Interrupt Mask Register
{0x110+0x20*i} HCTSIZ{i} (i=0..3) — Host Channel {i} Transfer Size Register

## Licence text in the file
The license belong to Realtek Semiconductor Corp. All the rights reserved.
